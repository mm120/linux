/*
 * THR1MIC Device Tree Source
 *
 * Copyright 2018 OMICRON electronics GmbH.
 *
 * This program is free software; you can redistribute	it and/or modify it
 * under  the terms of	the GNU General	 Public License as published by the
 * Free Software Foundation;  either version 2 of the  License, or (at your
 * option) any later version.
 */

/include/ "fsl/p1010si-pre.dtsi"

/ {
	model = "omicron,thr1mic";
	compatible = "omicron,thr1mic";

	/include/ "mic400_32b.dtsi"
};

/include/ "thr1mic.dtsi"

/include/ "fsl/p1010si-post.dtsi"

/*
 * Include this again so that we override the pci::interrupt-map data
 * from fsl/p1010si-post.dtsi
 */
/ {
	/include/ "mic400_32b.dtsi"
};
